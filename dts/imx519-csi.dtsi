// SPDX-License-Identifier: GPL-2.0
/*
 * Shared 24 MHz dummy clock and VDIG dummy regulator for IMX519.
 * Include this from a board .dts, then add the I2C node yourself
 * (see imx93-11x11-evk-imx519.dts).
 */

/ {
	clk_imx519_24m: clock-imx519-24m {
		compatible = "fixed-clock";
		#clock-cells = <0>;
		clock-frequency = <24000000>;
		clock-output-names = "imx519_xclk";
	};

	reg_imx519_vdig: regulator-imx519-vdig {
		compatible = "regulator-fixed";
		regulator-name = "imx519_vdig";
		regulator-min-microvolt = <1050000>;
		regulator-max-microvolt = <1050000>;
		regulator-always-on;
	};
};
